## main/Kconfig
```kconfig
# Vibe Pocket File Server - ESP32-S3 only

menu "Board configuration"

choice BOARD_PROFILE
    prompt "Hardware board"
    default BOARD_GENERIC_S3
    help
        Pick the module you are flashing. Pins, display, and flash/PSRAM
        defaults follow this choice. Use a matching sdkconfig (see README).

config BOARD_GENERIC_S3
    bool "Generic ESP32-S3 DevKit (SSD1306 + external SD)"
    help
        Typical ESP32-S3-DevKitC-1: SD on SPI 12/11/13/5, optional SSD1306
        on I2C 18/17, WS2812 on GPIO 48 (also driven on 38).

config BOARD_T_EMBED_CC1101
    bool "LilyGO T-Embed CC1101 (ST7789 + onboard TF)"
    help
        Onboard 170x320 ST7789, TF slot on the same SPI bus, 8x WS2812 on
        GPIO 14. CC1101 radio is left unused (CS held high). This is not
        the original T-Embed (non-CC1101) pinout: that board often uses
        SD CS 39. Do not flash this profile with DevKit SD pins 12/11/13/5.

endchoice

config BOARD_PWR_EN_GPIO
    int
    default 15
    depends on BOARD_T_EMBED_CC1101

config BOARD_RADIO_CS_GPIO
    int
    default 12
    depends on BOARD_T_EMBED_CC1101
    help
        CC1101 chip select. Held high so the radio stays off the SPI bus.

config SD_SPI_MISO_GPIO
    int "SD SPI MISO GPIO"
    default 10 if BOARD_T_EMBED_CC1101
    default 12
    range 0 48

config SD_SPI_MOSI_GPIO
    int "SD SPI MOSI GPIO"
    default 9 if BOARD_T_EMBED_CC1101
    default 11
    range 0 48

config SD_SPI_SCK_GPIO
    int "SD SPI SCK GPIO"
    default 11 if BOARD_T_EMBED_CC1101
    default 13
    range 0 48

config SD_SPI_CS_GPIO
    int "SD SPI CS GPIO"
    default 13 if BOARD_T_EMBED_CC1101
    default 5
    range 0 48

config DISPLAY_SSD1306
    bool "SSD1306 OLED status display (I2C)"
    default y
    depends on BOARD_GENERIC_S3
    help
        Drive an optional SSD1306 OLED over I2C. Status lines, contrast,
        rotation, and on/off are set on the Settings page.

        Leave this enabled even with no screen: init fails quietly and
        the file server still runs. Turn the panel off in Settings
        (Screen = Off) if you have an OLED but do not want it lit.

if DISPLAY_SSD1306

config DISPLAY_SSD1306_SDA_GPIO
    int "I2C SDA GPIO"
    default 18
    range 0 48
    help
        ESP32-S3 GPIO connected to the OLED SDA pin.
        Must not overlap SD SPI pins (5, 11, 12, 13).
        Do not use GPIO 46 (input-only / strapping).

config DISPLAY_SSD1306_SCL_GPIO
    int "I2C SCL GPIO"
    default 17
    range 0 48
    help
        ESP32-S3 GPIO connected to the OLED SCL (SCK) pin.
        Must not overlap SD SPI pins (5, 11, 12, 13).
        Do not use GPIO 46 (input-only / strapping).

config DISPLAY_SSD1306_I2C_ADDR
    hex "I2C address"
    default 3C
    help
        Most SSD1306 modules use 0x3C. Some use 0x3D.

choice DISPLAY_SSD1306_RESOLUTION
    prompt "OLED resolution"
    default DISPLAY_SSD1306_128X32
    help
        0.91 inch modules are usually 128x32.
        0.96 inch modules are usually 128x64.
        Using the wrong size produces a garbled or partial image.

config DISPLAY_SSD1306_128X32
    bool "128x32 (0.91 inch)"

config DISPLAY_SSD1306_128X64
    bool "128x64 (0.96 inch)"

endchoice

endif

config DISPLAY_ST7789
    bool
    default y
    depends on BOARD_T_EMBED_CC1101
    help
        Onboard ST7789 170x320 color TFT on T-Embed CC1101.

config DISPLAY_ST7789_CS_GPIO
    int
    default 41
    depends on DISPLAY_ST7789

config DISPLAY_ST7789_DC_GPIO
    int
    default 16
    depends on DISPLAY_ST7789

config DISPLAY_ST7789_BL_GPIO
    int
    default 21
    depends on DISPLAY_ST7789

config BOARD_ENCODER_A_GPIO
    int
    default 4
    depends on BOARD_T_EMBED_CC1101

config BOARD_ENCODER_B_GPIO
    int
    default 5
    depends on BOARD_T_EMBED_CC1101

config BOARD_ENCODER_BTN_GPIO
    int
    default 0
    depends on BOARD_T_EMBED_CC1101
    help
        T-Embed encoder push switch. GPIO 0 is also BOOT; click after boot.

config STATUS_LED
    bool "Onboard RGB LED (WS2812)"
    default y
    help
        Drive the onboard WS2812 as a dim status light. Default pattern
        is dim green. Change the pattern on the Settings page.

config STATUS_LED_GPIO
    int "RGB LED GPIO"
    default 14 if BOARD_T_EMBED_CC1101
    default 48
    range 0 48
    depends on STATUS_LED
    help
        ESP32-S3-DevKitC-1: GPIO 48. LilyGO T-Embed CC1101: GPIO 14.

config STATUS_LED_COUNT
    int "WS2812 LED count"
    default 8 if BOARD_T_EMBED_CC1101
    default 1
    range 1 16
    depends on STATUS_LED

config STATUS_LED_DRIVE_DEVKIT_ALT
    bool "Also drive GPIO 38 and 48 (DevKit LED pin variants)"
    default y
    depends on STATUS_LED && BOARD_GENERIC_S3
    help
        Some ESP32-S3 DevKits wire the RGB LED to GPIO 38 instead of 48.
        Leave this on for generic boards. Off for T-Embed CC1101: GPIO 38
        and 48 are CC1101 band-select pins.

config STATUS_LED_BRIGHTNESS
    int "LED brightness scale (1-64)"
    default 8
    range 1 64
    depends on STATUS_LED
    help
        8 is dim. 64 is full brightness. Keep this low; WS2812 LEDs are
        painful at full RGB (255,255,255).

endmenu
```

## sdkconfig.defaults
```kconfig
# Vibe Pocket File Server - ESP32-S3 default config
CONFIG_BOARD_GENERIC_S3=y
CONFIG_ESP32_WIFI_STATIC_RX_BUFFER_NUM=4
CONFIG_ESP32_WIFI_DYNAMIC_RX_BUFFER_NUM=8
CONFIG_ESP32_WIFI_DYNAMIC_TX_BUFFER_NUM=8
CONFIG_HTTPD_MAX_REQ_HDR_LEN=1024
CONFIG_HTTPD_MAX_URI_LEN=1024
CONFIG_LWIP_MAX_SOCKETS=16
CONFIG_STATUS_LED=y
CONFIG_STATUS_LED_GPIO=48
CONFIG_STATUS_LED_COUNT=1
CONFIG_STATUS_LED_DRIVE_DEVKIT_ALT=y
CONFIG_STATUS_LED_BRIGHTNESS=8
CONFIG_DISPLAY_SSD1306=y
CONFIG_DISPLAY_SSD1306_SDA_GPIO=18
CONFIG_DISPLAY_SSD1306_SCL_GPIO=17
CONFIG_DISPLAY_SSD1306_128X32=y
# CONFIG_DISPLAY_SSD1306_128X64 is not set
CONFIG_SD_SPI_MISO_GPIO=12
CONFIG_SD_SPI_MOSI_GPIO=11
CONFIG_SD_SPI_SCK_GPIO=13
CONFIG_SD_SPI_CS_GPIO=5
```

## sdkconfig.defaults.t-embed-cc1101
```kconfig
# LilyGO T-Embed CC1101 overlay. Applied after sdkconfig.defaults when
# building with -DBOARD=t-embed-cc1101.
CONFIG_BOARD_T_EMBED_CC1101=y
# CONFIG_BOARD_GENERIC_S3 is not set
# CONFIG_DISPLAY_SSD1306 is not set
CONFIG_DISPLAY_ST7789=y
CONFIG_STATUS_LED=y
CONFIG_STATUS_LED_GPIO=14
CONFIG_STATUS_LED_COUNT=8
# CONFIG_STATUS_LED_DRIVE_DEVKIT_ALT is not set
CONFIG_SD_SPI_MISO_GPIO=10
CONFIG_SD_SPI_MOSI_GPIO=9
CONFIG_SD_SPI_SCK_GPIO=11
CONFIG_SD_SPI_CS_GPIO=13
CONFIG_ESPTOOLPY_FLASHSIZE_16MB=y
CONFIG_ESPTOOLPY_FLASHMODE_QIO=y
CONFIG_ESPTOOLPY_FLASHFREQ_80M=y
CONFIG_SPIRAM=y
CONFIG_SPIRAM_MODE_OCT=y
CONFIG_SPIRAM_SPEED_80M=y
CONFIG_SPIRAM_BOOT_INIT=y
CONFIG_ESP_CONSOLE_USB_SERIAL_JTAG=y
# CONFIG_ESP_CONSOLE_UART_DEFAULT is not set
```
